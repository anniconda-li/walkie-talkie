## sdkconfig.defaults
```kconfig
# CONFIG_LV_USE_SYSMON is not set
# CONFIG_LV_USE_PERF_MONITOR is not set
# CONFIG_LV_USE_MEM_MONITOR is not set
# CONFIG_ESPTOOLPY_FLASHSIZE_2MB is not set
CONFIG_ESPTOOLPY_FLASHSIZE_16MB=y
CONFIG_ESPTOOLPY_FLASHSIZE="16MB"
# CONFIG_PARTITION_TABLE_SINGLE_APP_LARGE is not set
CONFIG_PARTITION_TABLE_CUSTOM=y
CONFIG_PARTITION_TABLE_CUSTOM_FILENAME="partitions.csv"
# CONFIG_LV_FONT_SOURCE_HAN_SANS_SC_14_CJK is not set
# CONFIG_LV_FONT_SOURCE_HAN_SANS_SC_16_CJK is not set
CONFIG_LV_FONT_FMT_TXT_LARGE=y
CONFIG_LV_FONT_DEFAULT_MONTSERRAT_14=y
# CONFIG_LV_FONT_DEFAULT_SOURCE_HAN_SANS_SC_16_CJK is not set
# CONFIG_ESP_WIFI_STA_DISCONNECTED_PM_ENABLE is not set
```
